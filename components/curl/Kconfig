## components/curl/Kconfig
```kconfig
config COMPONENT_CURL
	bool "Curl"
	default 0
    help
		cURL:command line tool and library for transferring data with URLs.
```

## components/ota-server/Kconfig
```kconfig
menuconfig COMPONENT_OTA
    bool "OTA"
    default 0
    help
		A component for ESP-IDF that adds OTA capability for your project easily.

config COMPONENT_OTA_MODE
    int
    default 0 if COMPONENT_OTA_PUSH
    default 1 if COMPONENT_OTA_PULL
    depends on COMPONENT_OTA
	choice
    	prompt "Select OTA mode"
    	depends on COMPONENT_OTA
    	config COMPONENT_OTA_PUSH
    	    bool "Push"
    	    help
    	        If selected a server will wait for updates to be pushed in.
    	config COMPONENT_OTA_PULL
    	    bool "Pull"
    	    help
    	        If selected the device will pull updates on command.
	endchoice

config COMPONENT_OTA_CORE
    int
    default 0 if COMPONENT_OTA_CORE_0
    default 1 if COMPONENT_OTA_CORE_1
    depends on COMPONENT_OTA
    depends on COMPONENT_OTA_PUSH
	config COMPONENT_AUTOSTART_OTA
    	bool "Autostart OTA server on boot"
    	default 0
    	depends on COMPONENT_OTA
    	depends on COMPONENT_OTA_PUSH
    	help
    	    By default OTA server stays suspended waiting for explicit resume.
    	    Enabling this option will resume the OTA server task on boot.

	choice
    	prompt "Select core for OTA"
    	depends on COMPONENT_OTA
    	depends on COMPONENT_OTA_PUSH
    	config COMPONENT_OTA_CORE_0
    	    bool "Core 0"
       		help
            	If selected OTA will be executed by PRO Core.
    	config COMPONENT_OTA_CORE_1
        	bool "Core 1"
        	select MEMMAP_SMP
        	help
            	If selected OTA will be executed by APP Core.
	endchoice
```

## components/ota-server/Kconfig.old
```kconfig
menu "OTA"

config MICROPY_USE_OTA
        bool "Use OTA partition layout"
        default n
        depends on ENABLE_OTA
         depends on OTA_PULL
         depends on ENABLE_MICROPYTHON
        help
            Use OTA partition layout and include OTA module into build
config GPIO_INPUT_FORCE_FACTORY
        bool "Use GPIO2 to force boot from Factory partition"
        depends on ENABLE_OTA
         depends on OTA_PULL
         depends on ENABLE_MICROPYTHON
        depends on MICROPY_USE_OTA
        default n
        help
            If OTA layout is enabled and OTA update has been executed
            the system will boot from one of the OTA partition
            To force boot from Factory partition GPIO2 must be high for 3 seconds during boot

endmenu
```

## components/templateplus/Kconfig
```kconfig
menu "Template Plus"

choice
    prompt "MCU"
    config D0WDQ6
        bool "Dual core ESP32"
        help
            ESP32-D0WDQ6.
    config S0WD
        bool "Single core ESP32"
        help
            ESP32-S0WD.
endchoice
config MCU_TYPE
    int
    default 0 if D0WDQ6
    default 1 if S0WD
config MICROPY_HW_MCU_NAME
    string
    default "ESP32-D0WDQ6" if D0WDQ6
    default "ESP32-S0WD" if S0WD

choice
    prompt "Board"
    depends on D0WDQ6
    config ESP32D
        depends on D0WDQ6
        bool "Generic dual core ESP32"
        help
            It should work on any ESP32 board, your mileage may vary.
    config M5STACK
        depends on D0WDQ6
        bool "M5Stack Core Gen1"
        help
            M5Stack Core Gen1 board.
endchoice
choice
    prompt "Board"
    depends on S0WD
    config ESP32S
        depends on S0WD
        bool "Generic single core ESP32"
        help
            It should work on any ESP32 board, your mileage may vary.
endchoice
config BOARD_TYPE
    int
    default 0 if ESP32D
    default 1 if M5STACK
    default 2 if ESP32S
config MICROPY_HW_BOARD_NAME
    string
    default "Generic Dual Core ESP32" if ESP32D
    default "M5Stack Core Gen1" if M5STACK
    default "Generic Single Core ESP32" if ESP32S

menu "SD Card configuration"
         depends on ENABLE_MICROPYTHON
        config SDCARD_MODE
            int
            default 1 if SDCARD_MODE1
            default 2 if SDCARD_MODE2
            default 3 if SDCARD_MODE3
        
            choice
                prompt "SD Card mode"
                default SDCARD_MODE3
                help
                    Select SD Card operating mode
            
                config SDCARD_MODE1
                    bool "SPI Mode"
                    depends on !MEMMAP_SPIRAM_ENABLE 
                config SDCARD_MODE2
                    bool "1-line SD Mode" 
                config SDCARD_MODE3
                    bool "4-line SD Mode" 
            endchoice

        config SDCARD_CLK
            int "CLK pin"
            depends on SDCARD_MODE1
            range 1 32
            default 14
            help
            Pin used as SPI CLK

        config SDCARD_MOSI
            int "MOSI pin"
            depends on SDCARD_MODE1
            range 1 32
            default 15
            help
            Pin used as SPI MOSI

        config SDCARD_MISO
            int "MISO pin"
            depends on SDCARD_MODE1
            range 1 32
            default 2
            help
            Pin used as SPI MISO

        config SDCARD_CS
            int "CS pin"
            depends on SDCARD_MODE1
            range 1 32
            default 13
            help
            Pin used as SPI CS
endmenu
        
menu "File systems"
         depends on ENABLE_MICROPYTHON
        config MICROPY_FATFS_MAX_OPEN_FILES
            int "Maximum number of opened files"
            range 4 24
            default 6
            help
            Maximum number of opened files

        config MICROPY_USE_SPIFFS
            bool "Use SPIFFS"
            default y
            help
            Use spiffs on spi Flash instead of FatFS

        config MICROPY_SDMMC_SHOW_INFO
            bool "Show SDCard/InternalFS info"
            default y
            help
            Show info after initializing SD card or internal FS
endmenu

config MICROPY_TIMEZONE
    string "Time zone"
    default "GMT0BST"
    help
        Set the default time zone string used when updating the time from NTP server
        You can use 'components/micropython/docs/zones.csv'
        file to find the time zone string.
        Use the second entry for your Region/city as the value set here. Example:
        For Zagreb, the zones.csv file contains :"Europe/Zagreb","CET-1CEST,M3.5.0,M10.5.0/3".
        You should put "CET-1CEST,M3.5.0,M10.5.0/3" or "CET-1CEST" as Time zone.

menu "WiFi"

config ENABLE_WIFI
    bool "WiFi"
    select LWIP_SO_RCVBUF
    select ETHERNET
    select WIFI_ENABLED
    select ESP32_PHY_CALIBRATION_AND_DATA_STORAGE
    select MEMMAP_SMP
    default "n"
config WIFI_SSID
    string "WiFi ssid"
    default ""
    depends on ENABLE_WIFI
    help
        The SSID it will connect on boot.
config WIFI_PASSWORD
    string "WiFi password"
    default ""
    depends on ENABLE_WIFI
    help
        The SSID's password to connect.
config WIFI_AUTOCONNECT
    bool "Connect on boot"
    depends on ENABLE_WIFI
    default "n"
    help
        If enabled it will connect on boot to the specified network.

endmenu

endmenu
```

## components/upython/Kconfig
```kconfig
menu "uPython"

config COMPONENT_UPY
	bool "Enable Micropython"
	default 0
    help
		A lean and efficient Python implementation for microcontrollers and constrained systems.

config COMPONENT_UPY_REPL
	bool "Enable Micropython REPL"
    help
		Micropython Read-Evaluate-Print Loop on console.

endmenu
```

## components/zlib/Kconfig
```kconfig
config COMPONENT_ZLIB
	bool "ZLIB"
	default 0
    help
		A Massively Spiffy Yet Delicately Unobtrusive Compression Library 
		(Also Free, Not to Mention Unencumbered by Patents).
```
